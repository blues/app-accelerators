## prj.conf
```kconfig
# Provides access to onboard LED
CONFIG_GPIO=y

# Notecard Communication Channel
CONFIG_I2C=y

# Required by `note-c`
CONFIG_NEWLIB_LIBC=y

# Debugging Configuration
CONFIG_PRINTK=y

# Include sensor drivers. Needed for using BME280.
CONFIG_SENSOR=y
```

## src/main.c
```c
// Standard C headers.
#include <stdlib.h>

// Zephyr headers.
#include <zephyr/kernel.h>

// Notecard headers.
#include "note-c/note.h"
#include "note_c_hooks.h"

// Application headers.
#include "alarm_publisher.h"
#include "bme280.h"
#include "env_updater.h"
#include "publisher.h"

// Uncomment this line and replace com.your-company:your-product-name with your
// ProductUID.
// #define PRODUCT_UID "com.your-company:your-product-name"

#ifndef PRODUCT_UID
#define PRODUCT_UID ""
#pragma message "PRODUCT_UID is not defined in this example. Please ensure your Notecard has a product identifier set before running this example or define it in code here. More details at https://bit.ly/product-uid"
#endif

// Notecard locking functions.
static bool notecardLocked = false;

#ifndef NOTECARD_LOCK_POLLS_MS
#define NOTECARD_LOCK_POLLS_MS 10
#endif

// Temperature in Fahrenheit.
#define TEMPERATURE_MIN_DEFAULT 32
#define TEMPERATURE_MAX_DEFAULT 95
// Relative humidity.
#define HUMID_MIN_DEFAULT 5
#define HUMID_MAX_DEFAULT 80
// Heat index in Fahrenheit.
#define HEAT_INDEX_MAX 95

#ifndef HUB_SET_TIMEOUT_SECONDS
#define HUB_SET_TIMEOUT_SECONDS 5
#endif

// Set this value higher to conserve power.
#ifndef OUTBOUND_SYNC_MINS
#define OUTBOUND_SYNC_MINS 1
#endif

// Attempt to get a lock on the I2C bus. This will spin forever until the lock
// is released.
void lockNotecard(void)
{
    while (notecardLocked) {
        NoteDelayMs(NOTECARD_LOCK_POLLS_MS);
    }

    notecardLocked = true;
}

void unlockNotecard(void)
{
    notecardLocked = false;
}

void main(void)
{
    // Initialize note-c references.
    NoteSetFnDefault(malloc, free, platform_delay, platform_millis);
    NoteSetFnDebugOutput(note_log_print);
    NoteSetFnNoteMutex(lockNotecard, unlockNotecard);
    NoteSetFnI2C(NOTE_I2C_ADDR_DEFAULT, NOTE_I2C_MAX_DEFAULT, note_i2c_reset,
                 note_i2c_transmit, note_i2c_receive);

    J *req = NoteNewRequest("hub.set");
    if (PRODUCT_UID[0]) {
       JAddStringToObject(req, "product", PRODUCT_UID);
    }
    JAddStringToObject(req, "mode", "periodic");
    // Sync outbound data every OUTBOUND_SYNC_MINS minutes. Alarm notes will
    // still be synced immediately.
    JAddNumberToObject(req, "outbound", OUTBOUND_SYNC_MINS);
    // The hub.set request may fail if it's sent shortly after power up. We use
    // NoteRequestWithRetry to give it a chance to succeed.
    if (!NoteRequestWithRetry(req, HUB_SET_TIMEOUT_SECONDS)) {
        printk("hub.set failed, aborting.\n");
        return;
    }

    Bme280Ctx* bme280Ctx;
    // Read the sensor every 30 seconds.
    uint32_t interval = 30;
    if ((bme280Ctx = bme280Init()) == NULL) {
        printk("bme280Init failed, aborting.\n");
        return;
    }
    if (!bme280Start(bme280Ctx, interval)) {
        printk("bme280Start failed, aborting.\n");
        return;
    }

    PublisherCtx* publisherCtx;
    // Publish the temperature and humidity every 2 minutes, by default. This
    // can be changed with the monitor_interval environment variable.
    interval = 120;
    if ((publisherCtx = publisherInit(bme280Ctx)) == NULL) {
        printk("publisherInit failed, aborting.\n");
        return;
    }
    if (!publisherStart(publisherCtx, interval)) {
        printk("publisherStart failed, aborting.\n");
        return;
    }

    AlarmPublisherCtx* alarmPublisherCtx;
    // Check for alarms every minute.
    interval = 60;
    if ((alarmPublisherCtx = alarmPublisherInit(bme280Ctx, interval,
        TEMPERATURE_MIN_DEFAULT, TEMPERATURE_MAX_DEFAULT, HUMID_MIN_DEFAULT,
        HUMID_MAX_DEFAULT, HEAT_INDEX_MAX)) == NULL) {
        printk("alarmPublisherInit failed, aborting.\n");
        return;
    }
    if (!alarmPublisherStart(alarmPublisherCtx)) {
        printk("alarmPublisherStart failed, aborting.\n");
        return;
    }

    EnvUpdaterCtx* envUpdaterCtx;
    // Check for environment variable updates every minute.
    interval = 60;
    if ((envUpdaterCtx = envUpdaterInit(publisherCtx,
        alarmPublisherCtx)) == NULL) {
        printk("envUpdaterInit failed, aborting.\n");
        return;
    }
    if (!envUpdaterStart(envUpdaterCtx, interval)) {
        printk("envUpdaterStart failed, aborting.\n");
        return;
    }

    while (true) {
        k_sleep(K_SECONDS(10));
    }
}

void NoteUserAgentUpdate(J *ua) {
    JAddStringToObject(ua, "app", "nf37");
}
```

## src/alarm_publisher.h
```c
#pragma once

// C standard headers.
#include <stdint.h>
#include <stdbool.h>

// Application headers.
#include "bme280.h"

struct AlarmPublisherCtx;
typedef struct AlarmPublisherCtx AlarmPublisherCtx;

typedef enum {
    TEMP_MIN,
    TEMP_MAX,
    HUMID_MIN,
    HUMID_MAX,
    HEAT_INDEX_MAX
} AlarmBound;

AlarmPublisherCtx *alarmPublisherInit(const Bme280Ctx* bme280Ctx,
    uint32_t checkInterval, double tempMin, double tempMax, double humidMin,
    double humidMax, double heatIndexMax);
bool alarmPublisherUpdateBound(AlarmPublisherCtx* ctx, AlarmBound bound,
    double newVal);
bool alarmPublisherStart(AlarmPublisherCtx *ctx);
bool alarmPublisherStop(AlarmPublisherCtx *ctx);

#define alarmPublisherUpdateTempMin(ctx, newVal) alarmPublisherUpdateBound(ctx, TEMP_MIN, newVal)
#define alarmPublisherUpdateTempMax(ctx, newVal) alarmPublisherUpdateBound(ctx, TEMP_MAX, newVal)
#define alarmPublisherUpdateHumidMin(ctx, newVal) alarmPublisherUpdateBound(ctx, HUMID_MIN, newVal)
#define alarmPublisherUpdateHumidMax(ctx, newVal) alarmPublisherUpdateBound(ctx, HUMID_MAX, newVal)
#define alarmPublisherUpdateHeatIndexMax(ctx, newVal) alarmPublisherUpdateBound(ctx, HEAT_INDEX_MAX, newVal)
```

## src/bme280.c
```c
// Standard C headers.
#include <math.h>
#include <stdlib.h>
#include <string.h>

// Zephyr headers.
#include <zephyr/kernel.h>
#include <zephyr/device.h>
#include <zephyr/drivers/sensor.h>

// Application headers.
#include "bme280.h"

struct Bme280Ctx {
    const struct device *dev;
    struct k_work readWorkItem;
    struct k_timer readTimer;
    double temperature;
    double humidity;
    double heatIndex;
};

// Forward declarations.
static const struct device *getDevice(void);
static void readTimerCb(struct k_timer *timer);
static void readWorkCb(struct k_work *item);

/**
 * Get the last recorded temperature and humidity values.
 *
 * @param ctx       The sensor context object.
 * @param temp      A pointer to a double to store the temperature value in. Can
 *                  be NULL.
 * @param humidity  A pointer to a double to store the humidity value in. Can be
 *                  NULL.
 * @param heatIndex A pointer to a double to store the heat index value in. Can
 *                  be NULL.
 *
 * @return True on success and false on failure.
 */
bool bme280GetData(const Bme280Ctx *ctx, double *temp, double *humidity,
    double *heatIndex)
{
    if (ctx == NULL) {
        printk("bme280GetData: error: Called with NULL ctx.\n");
        return false;
    }

    if (temp != NULL) {
        *temp = ctx->temperature;
    }

    if (humidity != NULL) {
        *humidity = ctx->humidity;
    }

    if (heatIndex != NULL) {
        *heatIndex = ctx->heatIndex;
    }

    return true;
}

/**
 * Allocate and initialize a new sensor context.
 *
 * @return A valid Bme280Ctx pointer on success and NULL on failure.
 */
Bme280Ctx *bme280Init(void)
{
    Bme280Ctx *ctx = (Bme280Ctx *)malloc(sizeof(Bme280Ctx));
    if (ctx == NULL) {
        printk("bme280Init: error: failed to allocate Bme280Ctx.\n");
        return NULL;
    }
    memset(ctx, 0, sizeof(*ctx));

    ctx->dev = getDevice();
    if (ctx->dev == NULL) {
        printk("bme280Init: error: getDevice failed.\n");
        free(ctx);
        return NULL;
    }

    k_work_init(&ctx->readWorkItem, readWorkCb);
    k_timer_init(&ctx->readTimer, readTimerCb, NULL);

    printk("bme280Init: Initialized sensor.\n");

    return ctx;
}

/**
 * Start the sensor reading timer. The sensor will be read periodically
 * according to the interval.
 *
 * @param ctx      The sensor context object.
 * @param interval The sensor reading interval, in seconds.
 *
 * @return True on success and false on failure.
 */
bool bme280Start(Bme280Ctx *ctx, uint32_t interval)
{
    if (ctx == NULL) {
        printk("bme280Start: error: Called with NULL ctx.\n");
        return false;
    }
    if (interval == 0) {
        printk("bme280Start: error: Called with 0 interval. Must be > 0.\n");
        return false;
    }

    k_timer_start(&ctx->readTimer, K_SECONDS(0), K_SECONDS(interval));

    return true;
}

/**
 * Stop the sensor reading timer. No new readings will be performed until
 * bme280Start is called again.
 *
 * @param ctx The sensor context object.
 *
 * @return True on success and false on failure.
 */
bool bme280Stop(Bme280Ctx *ctx)
{
    if (ctx == NULL) {
        printk("bme280Stop: error: Called with NULL ctx.\n");
        return false;
    }

    k_timer_stop(&ctx->readTimer);

    return true;
}

/**
 * Compute the heat index based on the temperature and relative humidity. Uses
 * the algorithm described here:
 * https://www.wpc.ncep.noaa.gov/html/heatindex_equation.shtml
 *
 * @param temp  The temperature, in Fahrenheit.
 * @param humid The relative humidity.
 *
 * @return The computed heat index, in Fahrenheit.
 */
static double calcHeatIndex(double temp, double humid)
{
    double heatIndex = 0.5 * (temp + 61.0 + ((temp-68.0)*1.2) + (humid*0.094));

    if ((heatIndex + temp) / 2 >= 80) {
        heatIndex = -42.379 + 2.04901523*temp + 10.14333127*humid
                    - .22475541*temp*humid - .00683783*temp*temp
                    - .05481717*humid*humid + .00122874*temp*temp*humid
                    + .00085282*temp*humid*humid
                    - .00000199*temp*temp*humid*humid;

        if (humid < 13 && temp > 80 && temp < 112) {
            heatIndex -=  ((13-humid)/4)*sqrt((17-abs(temp-95.))/17);
        }
        else if (humid > 85 && temp > 80 && temp < 87) {
            heatIndex += ((humid-85)/10) * ((87-temp)/5);
        }
    }

    return heatIndex;
}

/**
 * Get a device handle for the BME280.
 *
 * @return A valid device pointer on success and NULL on failure.
 */
static const struct device *getDevice(void)
{
    const struct device *const dev = DEVICE_DT_GET_ANY(bosch_bme280);

    if (dev == NULL) {
        // No such node, or the node does not have status "okay".
        printk("getDevice: error: no BME280 found.\n");
        return NULL;
    }

    if (!device_is_ready(dev)) {
        printk("getDevice: error: Device \"%s\" is not ready; "
               "check the driver initialization logs for errors.\n",
               dev->name);
        return NULL;
    }

    printk("getDevice: Found device \"%s\".\n", dev->name);

    return dev;
}

/**
 * Read the temperature and humidity from the sensor and store the results in
 * the sensor context;
 *
 * @param ctx The sensor context object.
 *
 * @return True on success and false on failure.
 */
static bool readSensor(Bme280Ctx* ctx)
{
    if (ctx == NULL) {
        printk("readSensor: error: Called with NULL ctx.\n");
        return false;
    }

    struct sensor_value temp, humid;

    int rc;
    if ((rc = sensor_sample_fetch(ctx->dev)) != 0) {
        printk("readSensor: error: sensor_sample_fetch failed (%d).\n", rc);
        return false;
    }

    sensor_channel_get(ctx->dev, SENSOR_CHAN_AMBIENT_TEMP, &temp);
    sensor_channel_get(ctx->dev, SENSOR_CHAN_HUMIDITY, &humid);

    // Multiply sensor value by 1.8 and add 32 to convert Celsius to Fahrenheit.
    ctx->temperature = sensor_value_to_double(&temp) * 1.8 + 32;
    ctx->humidity = sensor_value_to_double(&humid);
    ctx->heatIndex = calcHeatIndex(ctx->temperature, ctx->humidity);

    printk("readSensor: temp: %dF, humidity: %d%%, heat index: %dF.\n",
           (int)ctx->temperature, (int)ctx->humidity, (int)ctx->heatIndex);

    return true;
}

/**
 * Callback that will be executed when the sensor reading timer expires.
 *
 * @param timer The timer handle.
 */
static void readTimerCb(struct k_timer *timer)
{
    Bme280Ctx *ctx = CONTAINER_OF(timer, Bme280Ctx, readTimer);
    k_work_submit(&ctx->readWorkItem);
}

/**
 * Callback that will be executed by the system workqueue when it's time to do a
 * sensor reading.
 *
 * @param item The sensor reading work item.
 */
static void readWorkCb(struct k_work *item)
{
    Bme280Ctx *ctx = CONTAINER_OF(item, Bme280Ctx, readWorkItem);
    readSensor(ctx);
}
```

## src/bme280.h
```c
#pragma once

struct Bme280Ctx;
typedef struct Bme280Ctx Bme280Ctx;

Bme280Ctx *bme280Init(void);
bool bme280GetData(const Bme280Ctx *ctx, double *temp, double *humidity,
    double *heatIndex);
bool bme280Start(Bme280Ctx *ctx, uint32_t interval);
bool bme280Stop(Bme280Ctx *ctx);
```

## src/note_c_hooks.c
```c
#include "note_c_hooks.h"

#include <zephyr/drivers/i2c.h>
#include <zephyr/kernel.h>

static const size_t REQUEST_HEADER_SIZE = 2;

const struct device *i2c_dev = NULL;
bool i2c_initialized = false;

uint32_t platform_millis(void) {
    return (uint32_t)k_uptime_get();
}

void platform_delay(uint32_t ms) {
    k_msleep(ms);
}

const char *note_i2c_receive(uint16_t device_address_, uint8_t *buffer_, uint16_t size_, uint32_t *available_) {
    // Let the Notecard know that we are getting ready to read some data
    uint8_t size_buf[2];
    size_buf[0] = 0;
    size_buf[1] = (uint8_t)size_;
    uint8_t write_result = i2c_write(i2c_dev, size_buf, sizeof(size_buf), device_address_);

    if (write_result != 0) {
        return "i2c: Unable to initate read from the Notecard\n";
    }

    // Read from the Notecard and copy the response bytes into the response buffer
    const int request_length = size_ + REQUEST_HEADER_SIZE;
    uint8_t read_buf[256];
    uint8_t read_result = i2c_read(i2c_dev, read_buf, request_length, device_address_);

    if (read_result != 0) {
        return "i2c: Unable to receive data from the Notecard.\n";
    } else {
        *available_ = (uint32_t)read_buf[0];
        uint8_t bytes_to_read = read_buf[1];
        for (size_t i = 0; i < bytes_to_read; i++) {
            buffer_[i] = read_buf[i + 2];
        }

        return NULL;
    }
}

bool note_i2c_reset(uint16_t device_address_) {
    (void)device_address_;

    if (i2c_initialized) {
        return true;
    }

    if (!i2c_dev) {
        i2c_dev = DEVICE_DT_GET(DT_NODELABEL(i2c1));
    }

    if (!device_is_ready(i2c_dev)) {
        printk("i2c: Device is not ready.\n");
        return false;
    }

    printk("i2c: Device is ready.\n");

    i2c_initialized = true;
    return true;
}

const char *note_i2c_transmit(uint16_t device_address_, uint8_t *buffer_, uint16_t size_) {
    // Create a buffer that contains the number of bytes and the data to write to the Notecard
    uint8_t write_buf[size_ + 1];
    write_buf[0] = (uint8_t)size_;
    for (size_t i = 0; i < size_; i++) {
        write_buf[i + 1] = buffer_[i];
    }

    // Write the message
    uint8_t write_result = i2c_write(i2c_dev, write_buf, sizeof(write_buf), device_address_);

    if (write_result != 0) {
        return "i2c: Unable to transmit data to the Notecard\n";
    } else {
        return NULL;
    }
}

size_t note_log_print(const char *message_) {
    if (message_) {
        printk("%s", message_);
        return 1;
    }

    return 0;
}
```

## src/note_c_hooks.h
```c
#ifndef NOTE_C_HOOKS_H
#define NOTE_C_HOOKS_H

#include <stdbool.h>
#include <stdint.h>
#include <stdlib.h>

void platform_delay(uint32_t ms);
uint32_t platform_millis(void);

const char *note_i2c_receive(uint16_t device_address_, uint8_t *buffer_, uint16_t size_, uint32_t *available_);
bool note_i2c_reset(uint16_t device_address_);
const char *note_i2c_transmit(uint16_t device_address_, uint8_t *buffer_, uint16_t size_);

size_t note_log_print(const char *message_);

#endif // NOTE_C_HOOKS_H
```
