## CMakeLists.txt
```
cmake_minimum_required(VERSION 3.20.0)

find_package(Zephyr REQUIRED HINTS $ENV{ZEPHYR_BASE})

project(heat_index_monitor)

set(SRC_DIR ${CMAKE_CURRENT_LIST_DIR}/src)
set(NOTE_C_DIR ${SRC_DIR}/note-c)
set(NEVM_SRC_DIR ${SRC_DIR}/notecard_env_var_manager/src)

target_sources(
    app
    PRIVATE
        # Application sources.
        ${SRC_DIR}/alarm_publisher.c
        ${SRC_DIR}/bme280.c
        ${SRC_DIR}/env_updater.c
        ${SRC_DIR}/main.c
        ${SRC_DIR}/note_c_hooks.c
        ${SRC_DIR}/publisher.c
        # note-c sources.
        ${NOTE_C_DIR}/n_atof.c
        ${NOTE_C_DIR}/n_cjson.c
        ${NOTE_C_DIR}/n_const.c
        ${NOTE_C_DIR}/n_helpers.c
        ${NOTE_C_DIR}/n_i2c.c
        ${NOTE_C_DIR}/n_printf.c
        ${NOTE_C_DIR}/n_serial.c
        ${NOTE_C_DIR}/n_ua.c
        ${NOTE_C_DIR}/n_b64.c
        ${NOTE_C_DIR}/n_cjson_helpers.c
        ${NOTE_C_DIR}/n_ftoa.c
        ${NOTE_C_DIR}/n_hooks.c
        ${NOTE_C_DIR}/n_md5.c
        ${NOTE_C_DIR}/n_request.c
        ${NOTE_C_DIR}/n_str.c
        # note_env_var_manager sources.
        ${NEVM_SRC_DIR}/NotecardEnvVarManager.c
)
target_include_directories(
    app
    PRIVATE
        ${SRC_DIR}
        ${NEVM_SRC_DIR}
)
```

## prj.conf
```kconfig
CONFIG_GPIO=y
CONFIG_USB_DEVICE_STACK=y
CONFIG_USB_DEVICE_PRODUCT="Notecard Temperature and Humidity Monitor"
CONFIG_USB_DEVICE_VID=4440

CONFIG_SERIAL=y
CONFIG_CONSOLE=y
CONFIG_UART_CONSOLE=y
CONFIG_UART_LINE_CTRL=y

CONFIG_I2C=y

CONFIG_NEWLIB_LIBC=y

# Debugging Configuration
# CONFIG_OPENOCD_SUPPORT=y
CONFIG_PRINTK=y

CONFIG_SENSOR=y
```

## src/main.c
```c
// Standard C headers.
#include <stdlib.h>

// Zephyr headers.
#include <zephyr/kernel.h>

// Notecard headers.
#include "note-c/note.h"
#include "note_c_hooks.h"

// Application headers.
#include "alarm_publisher.h"
#include "bme280.h"
#include "env_updater.h"
#include "publisher.h"

// Uncomment this line and replace com.your-company:your-product-name with your
// ProductUID.
// #define PRODUCT_UID "com.your-company:your-product-name"

#ifndef PRODUCT_UID
#define PRODUCT_UID ""
#pragma message "PRODUCT_UID is not defined in this example. Please ensure your Notecard has a product identifier set before running this example or define it in code here. More details at https://bit.ly/product-uid"
#endif

// Notecard locking functions.
static bool notecardLocked = false;

#ifndef NOTECARD_LOCK_POLLS_MS
#define NOTECARD_LOCK_POLLS_MS 10
#endif

// Temperature in Fahrenheit.
#define TEMPERATURE_MIN_DEFAULT 32
#define TEMPERATURE_MAX_DEFAULT 95
// Relative humidity.
#define HUMID_MIN_DEFAULT 5
#define HUMID_MAX_DEFAULT 80
// Heat index in Fahrenheit.
#define HEAT_INDEX_MAX 95

#ifndef HUB_SET_TIMEOUT_SECONDS
#define HUB_SET_TIMEOUT_SECONDS 5
#endif

// Set this value higher to conserve power.
#ifndef OUTBOUND_SYNC_MINS
#define OUTBOUND_SYNC_MINS 1
#endif

// Attempt to get a lock on the I2C bus. This will spin forever until the lock
// is released.
void lockNotecard(void)
{
    while (notecardLocked) {
        NoteDelayMs(NOTECARD_LOCK_POLLS_MS);
    }

    notecardLocked = true;
}

void unlockNotecard(void)
{
    notecardLocked = false;
}

void main(void)
{
    // Initialize note-c references.
    NoteSetFnDefault(malloc, free, platform_delay, platform_millis);
    NoteSetFnDebugOutput(note_log_print);
    NoteSetFnNoteMutex(lockNotecard, unlockNotecard);
    NoteSetFnI2C(NOTE_I2C_ADDR_DEFAULT, NOTE_I2C_MAX_DEFAULT, note_i2c_reset,
                 note_i2c_transmit, note_i2c_receive);

    J *req = NoteNewRequest("hub.set");
    if (PRODUCT_UID[0]) {
       JAddStringToObject(req, "product", PRODUCT_UID);
    }
    JAddStringToObject(req, "mode", "periodic");
    // Sync outbound data every OUTBOUND_SYNC_MINS minutes. Alarm notes will
    // still be synced immediately.
    JAddNumberToObject(req, "outbound", OUTBOUND_SYNC_MINS);
    // The hub.set request may fail if it's sent shortly after power up. We use
    // NoteRequestWithRetry to give it a chance to succeed.
    if (!NoteRequestWithRetry(req, HUB_SET_TIMEOUT_SECONDS)) {
        printk("hub.set failed, aborting.\n");
        return;
    }

    Bme280Ctx* bme280Ctx;
    // Read the sensor every 30 seconds.
    uint32_t interval = 30;
    if ((bme280Ctx = bme280Init()) == NULL) {
        printk("bme280Init failed, aborting.\n");
        return;
    }
    if (!bme280Start(bme280Ctx, interval)) {
        printk("bme280Start failed, aborting.\n");
        return;
    }

    PublisherCtx* publisherCtx;
    // Publish the temperature and humidity every 2 minutes, by default. This
    // can be changed with the monitor_interval environment variable.
    interval = 120;
    if ((publisherCtx = publisherInit(bme280Ctx)) == NULL) {
        printk("publisherInit failed, aborting.\n");
        return;
    }
    if (!publisherStart(publisherCtx, interval)) {
        printk("publisherStart failed, aborting.\n");
        return;
    }

    AlarmPublisherCtx* alarmPublisherCtx;
    // Check for alarms every minute.
    interval = 60;
    if ((alarmPublisherCtx = alarmPublisherInit(bme280Ctx, interval,
        TEMPERATURE_MIN_DEFAULT, TEMPERATURE_MAX_DEFAULT, HUMID_MIN_DEFAULT,
        HUMID_MAX_DEFAULT, HEAT_INDEX_MAX)) == NULL) {
        printk("alarmPublisherInit failed, aborting.\n");
        return;
    }
    if (!alarmPublisherStart(alarmPublisherCtx)) {
        printk("alarmPublisherStart failed, aborting.\n");
        return;
    }

    EnvUpdaterCtx* envUpdaterCtx;
    // Check for environment variable updates every minute.
    interval = 60;
    if ((envUpdaterCtx = envUpdaterInit(publisherCtx,
        alarmPublisherCtx)) == NULL) {
        printk("envUpdaterInit failed, aborting.\n");
        return;
    }
    if (!envUpdaterStart(envUpdaterCtx, interval)) {
        printk("envUpdaterStart failed, aborting.\n");
        return;
    }

    while (true) {
        k_sleep(K_SECONDS(10));
    }
}
```

## src/alarm_publisher.c
```c
// Standard C headers.
#include <stdio.h>
#include <stdlib.h>
#include <string.h>

// Zephyr headers.
#include <zephyr/kernel.h>

// Notecard headers.
#include "note-c/note.h"

// Application headers.
#include "alarm_publisher.h"

struct AlarmPublisherCtx {
    const Bme280Ctx *bme280Ctx;
    struct k_timer alarmCheckTimer;
    struct k_timer alarmCooldownTimer;
    struct k_work alarmCheckWorkItem;
    double tempMin;
    double tempMax;
    double humidMin;
    double humidMax;
    double heatIndexMax;
    uint32_t checkInterval;
    bool started;
    volatile bool coolingDown;
};

// Forward declarations.
static void checkAlarm(AlarmPublisherCtx *ctx);
static bool publishAlarm(const char *tempStatus,
    const char *humidStatus, const char *heatIndexStatus, double temp,
    double humid, double heatIndex);

static const char statusOk[] = "ok";
static const char statusLow[] = "low";
static const char statusHigh[] = "high";

// The user can define ALARM_COOLDOWN_SECONDS to override the cooldown timer
// interval.
#ifndef ALARM_COOLDOWN_SECONDS
#define ALARM_COOLDOWN_SECONDS (60 * 5) // 5 minutes
#endif

/**
 * Callback that will be executed when the alarm check timer expires.
 *
 * @param timer The timer handle.
 */
static void alarmCheckTimerCb(struct k_timer *timer)
{
    AlarmPublisherCtx *ctx = CONTAINER_OF(timer, AlarmPublisherCtx,
        alarmCheckTimer);
    k_work_submit(&ctx->alarmCheckWorkItem);
}

/**
 * Callback that will be executed by the system workqueue when it's time to
 * check for alarm conditions.
 *
 * @param item The alarm check work item.
 */
static void alarmCheckWorkCb(struct k_work *item)
{
    AlarmPublisherCtx *ctx = CONTAINER_OF(item, AlarmPublisherCtx,
        alarmCheckWorkItem);
    checkAlarm(ctx);
}

/**
 * Callback that will be executed when the alarm cooldown timer expires.
 *
 * @param timer The timer handle.
 */
static void alarmCooldownTimerCb(struct k_timer *timer)
{
    AlarmPublisherCtx *ctx = CONTAINER_OF(timer, AlarmPublisherCtx,
        alarmCooldownTimer);
    ctx->coolingDown = false;
}

/**
 * Allocate and initialize a new alarm publisher context.
 *
 * @param bme280Ctx     A BME280 context object.
 * @param checkInterval The interval to check for alarm conditions, in seconds.
 * @param tempMin       The minimum allowed temperature.
 * @param tempMax       The maximum allowed temperature.
 * @param humidMin      The minimum allowed humidity.
 * @param humidMax      The maximum allowed humidity.
 * @param heatIndexMax  The maximum allowed heat index.
 *
 * @return A valid AlarmPublisherCtx pointer on success and NULL on failure.
 */
AlarmPublisherCtx *alarmPublisherInit(const Bme280Ctx* bme280Ctx,
    uint32_t checkInterval, double tempMin, double tempMax, double humidMin,
    double humidMax, double heatIndexMax)
{
    if (bme280Ctx == NULL) {
        printk("alarmPublisherInit: error: Called with NULL bme280Ctx.\n");
        return NULL;
    }
    if (checkInterval == 0) {
        printk("alarmPublisherInit: error: Called with 0 check interval. Must "
            "be > 0.\n");
        return NULL;
    }

    AlarmPublisherCtx *ctx = (AlarmPublisherCtx *)malloc(
        sizeof(AlarmPublisherCtx));
    if (ctx == NULL) {
        printk("alarmPublisherInit: error: failed to allocate PublisherCtx.\n");
        return NULL;
    }
    memset(ctx, 0, sizeof(*ctx));

    ctx->bme280Ctx = bme280Ctx;
    ctx->checkInterval = checkInterval;
    ctx->tempMin = tempMin;
    ctx->tempMax = tempMax;
    ctx->humidMin = humidMin;
    ctx->humidMax = humidMax;
    ctx->heatIndexMax = heatIndexMax;

    k_timer_init(&ctx->alarmCheckTimer, alarmCheckTimerCb, NULL);
    k_timer_init(&ctx->alarmCooldownTimer, alarmCooldownTimerCb, NULL);
    k_work_init(&ctx->alarmCheckWorkItem, alarmCheckWorkCb);

    printk("alarmPublisherInit: Initialized alarm publisher.\n");

    return ctx;
}

/**
 * Start the alarm check timer. Alarm conditions will be checked according to
 * the interval passed to alarmPublisherInit.
 *
 * @param ctx The publisher context object.
 *
 * @return True on success and false on failure.
 */
bool alarmPublisherStart(AlarmPublisherCtx *ctx)
{
    if (ctx == NULL) {
        printk("alarmPublisherStart: error: Called with NULL ctx.\n");
        return false;
    }

    k_timer_start(&ctx->alarmCheckTimer, K_SECONDS(0),
        K_SECONDS(ctx->checkInterval));
    ctx->started = true;

    return true;
}

/**
 * Stop the alarm check timer. Alarm conditions won't be checked until
 * alarmPublisherStart is called again.
 *
 * @param ctx The publisher context object.
 *
 * @return True on success and false on failure.
 */
bool alarmPublisherStop(AlarmPublisherCtx *ctx)
{
    if (ctx == NULL) {
        printk("alarmPublisherStop: error: Called with NULL ctx.\n");
        return false;
    }

    k_timer_stop(&ctx->alarmCheckTimer);
    ctx->started = false;

    return true;
}

/**
 * Update one of the bounds used for triggering alarms.
 *
 * @param ctx    An alarm publisher context object.
 * @param bound  The bound to update. See alarm_publisher.h's AlarmBound enum
 *               for possible values.
 * @param newVal The new value for the bound.
 *
 * @return True on success and false on failure.
 */
bool alarmPublisherUpdateBound(AlarmPublisherCtx* ctx, AlarmBound bound,
    double newVal)
{
    if (ctx == NULL) {
        printk("alarmPublisherUpdateBound: error: Called with NULL ctx.\n");
        return false;
    }

    double *field;
    switch (bound) {
        case TEMP_MIN:
            field = &ctx->tempMin;
            break;
        case TEMP_MAX:
            field = &ctx->tempMax;
            break;
        case HUMID_MIN:
            field = &ctx->humidMin;
            break;
        case HUMID_MAX:
            field = &ctx->humidMax;
            break;
        case HEAT_INDEX_MAX:
            field = &ctx->heatIndexMax;
            break;
        default:
            printk("alarmPublisherUpdateBound: error: Unrecognized bound.\n");
            return false;
    }

    k_timer_stop(&ctx->alarmCheckTimer);
    k_timer_stop(&ctx->alarmCooldownTimer);
    ctx->coolingDown = false;

    *field = newVal;

    if (ctx->started) {
        k_timer_start(&ctx->alarmCheckTimer, K_SECONDS(0),
            K_SECONDS(ctx->checkInterval));
    }

    return true;
}

/**
 * Check to see if temperature or humidity are out of bounds and, if so, publish
 * an alarm.
 *
 * @param ctx An alarm publisher context object.
 */
static void checkAlarm(AlarmPublisherCtx *ctx)
{
    // If we're in the alarm cooldown period, don't check alarm conditions.
    if (ctx->coolingDown) {
        return;
    }

    double temp, humid, heatIndex;
    if (!bme280GetData(ctx->bme280Ctx, &temp, &humid, &heatIndex)) {
        printk("checkAlarm: error: bme280GetData failed.\n");
        return;
    }

    const char *tempStatus = statusOk;
    const char *humidStatus = statusOk;
    const char *heatIndexStatus = statusOk;

    // We use printf for these alarm logs because printk doesn't support
    // printing doubles.
    if (temp < ctx->tempMin) {
        tempStatus = statusLow;
        printf("checkAlarm: temp is low @ %.2f, min is %.2f.\n", temp,
            ctx->tempMin);
    }
    else if (temp > ctx->tempMax) {
        tempStatus = statusHigh;
        printf("checkAlarm: temp is high @ %.2f, max is %.2f.\n", temp,
            ctx->tempMax);
    }

    if (humid < ctx->humidMin) {
        humidStatus = statusLow;
        printf("checkAlarm: humid is low @ %.2f, min is %.2f.\n", humid,
            ctx->humidMin);
    }
    else if (humid > ctx->humidMax) {
        humidStatus = statusHigh;
        printf("checkAlarm: humid is high @ %.2f, max is %.2f.\n", humid,
            ctx->humidMax);
    }

    if (heatIndex > ctx->heatIndexMax) {
        heatIndexStatus = statusHigh;
        printf("checkAlarm: heat index is high @ %.2f, max is %.2f.\n",
            heatIndex, ctx->heatIndexMax);
    }

    // If any status is not "ok".
    if (strcmp(tempStatus, statusOk) || strcmp(humidStatus, statusOk) ||
        strcmp(heatIndexStatus, statusOk)) {
        if (!publishAlarm(tempStatus, humidStatus, heatIndexStatus, temp, humid,
            heatIndex)) {
            printk("checkAlarm: error: publishAlarm failed.\n");
            return;
        }

        // To avoid spamming Notehub about the same alarm condition over and
        // over, we use a cooldown timer. Once we publish an alarm, this timer
        // counts down from ALARM_COOLDOWN_SECONDS. Only once that timer hits
        // 0 are we allowed to publish another alarm.
        ctx->coolingDown = true;
        k_timer_start(&ctx->alarmCooldownTimer,
            K_SECONDS(ALARM_COOLDOWN_SECONDS), K_FOREVER);
    }
}

/**
 * Publish an alarm note to Notehub.
 *
 * @param tempStatus      A string with the temperature alarm status.
 * @param humidStatus     A string with the humidity alarm status.
 * @param heatIndexStatus A string with the heat index alarm status.
 * @param temp            The temperature at the time the alarm was triggered.
 * @param humid           The humidity at the time the alarm was triggered.
 * @param heatIndex       The heat index at the time the alarm was triggered.
 *
 * @return True on success and false on failure.
 */
static bool publishAlarm(const char *tempStatus,
    const char *humidStatus, const char *heatIndexStatus, double temp,
    double humid, double heatIndex)
{
    J *req = NoteNewRequest("note.add");
    J *body = JCreateObject();
    J *temperatureBody = JCreateObject();
    J *humidityBody = JCreateObject();
    J *heatIndexBody = JCreateObject();
    if (req == NULL || body == NULL || temperatureBody == NULL ||
        humidityBody == NULL || heatIndexBody == NULL) {
        printk("publishAlarm: error: Failed to allocate memory for alarm note."
            "\n");
        return false;
    }

    JAddStringToObject(req, "file", "alarm.qo");
    JAddBoolToObject(req, "sync", true);

    JAddNumberToObject(temperatureBody, "value", temp);
    JAddStringToObject(temperatureBody, "status",
        tempStatus);
    JAddItemToObject(body, "temperature", temperatureBody);

    JAddNumberToObject(humidityBody, "value", humid);
    JAddStringToObject(humidityBody, "status", humidStatus);
    JAddItemToObject(body, "humidity", humidityBody);

    JAddNumberToObject(heatIndexBody, "value", heatIndex);
    JAddStringToObject(heatIndexBody, "status", heatIndexStatus);
    JAddItemToObject(body, "heat_index", heatIndexBody);

    JAddItemToObject(req, "body", body);

    if (!NoteRequest(req)) {
        printk("publishAlarm: error: Failed to send alarm note.\n");
        return false;
    }

    printk("publishAlarm: Sent alarm note.\n");

    return true;
}
```

## src/env_updater.c
```c
// Standard C headers.
#include <stdlib.h>
#include <string.h>

// Zephyr headers.
#include <zephyr/kernel.h>

// Notecard headers.
#include "NotecardEnvVarManager.h"

// Application headers.
#include "env_updater.h"
#include "publisher.h"

struct EnvUpdaterCtx {
    PublisherCtx *publisherCtx;
    AlarmPublisherCtx *alarmPublisherCtx;
    NotecardEnvVarManager *envVarManager;
    struct k_work envUpdateWorkItem;
    struct k_timer envUpdateTimer;
    uint32_t envLastModTime;
    uint32_t interval;
};

// Forward declarations.
static void envUpdateTimerCb(struct k_timer *timer);
static void envUpdateWorkCb(struct k_work *item);

static const char *envVars[] = {
    "monitor_interval",
    "temperature_min",
    "temperature_max",
    "humidity_min",
    "humidity_max",
    "heat_index_max"
};
static const size_t numEnvVars = sizeof(envVars) / sizeof(envVars[0]);

static void envVarManagerCb(const char *var, const char *val, void *userCtx)
{
    EnvUpdaterCtx* envUpdaterCtx = (EnvUpdaterCtx*)userCtx;
    float value;
    char *endPtr;

    value = strtof(val, &endPtr);
    if ((value == 0 && val == endPtr) || value < 0) {
        printk("envVarManagerCb: error: Failed to convert %s to positive float "
            "for %s.\n", val, var);
        return;
    }

    if (strcmp(var, "monitor_interval") == 0) {
        uint32_t interval = (uint32_t)(value);
        printk("envVarManagerCb: Monitor interval set to %u seconds.\n",
            interval);
        // If the monitor interval changed, we need to restart the publisher
        // using the new interval value.
        publisherStop(envUpdaterCtx->publisherCtx);
        publisherStart(envUpdaterCtx->publisherCtx, interval);
    }
    else if (strcmp(var, "temperature_min") == 0) {
        alarmPublisherUpdateTempMin(envUpdaterCtx->alarmPublisherCtx, value);
        printk("envVarManagerCb: Temperature min set to %sF.\n", val);
    }
    else if (strcmp(var, "temperature_max") == 0) {
        alarmPublisherUpdateTempMax(envUpdaterCtx->alarmPublisherCtx, value);
        printk("envVarManagerCb: Temperature max set to %sF.\n", val);
    }
    else if (strcmp(var, "humidity_min") == 0) {
        alarmPublisherUpdateHumidMin(envUpdaterCtx->alarmPublisherCtx, value);
        printk("envVarManagerCb: Humidity min set to %s%%.\n", val);
    }
    else if (strcmp(var, "humidity_max") == 0) {
        alarmPublisherUpdateHumidMax(envUpdaterCtx->alarmPublisherCtx, value);
        printk("envVarManagerCb: Humidity max set to %s%%.\n", val);
    }
    else if (strcmp(var, "heat_index_max") == 0) {
        alarmPublisherUpdateHeatIndexMax(envUpdaterCtx->alarmPublisherCtx,
            value);
        printk("envVarManagerCb: Heat index max set to %sF.\n", val);
    }
}

/**
 * Allocate and initialize a new environment variable updater context.
 *
 * @param publisherCtx      A publisher context object.
 * @param alarmPublisherCtx An alarm publisher context object.
 *
 * @return A valid EnvUpdaterCtx pointer on success and NULL on failure.
 */
EnvUpdaterCtx *envUpdaterInit(PublisherCtx* publisherCtx,
    AlarmPublisherCtx* alarmPublisherCtx)
{
    if (publisherCtx == NULL) {
        printk("envUpdaterInit: error: Called with NULL publisherCtx.\n");
        return NULL;
    }

    EnvUpdaterCtx *ctx = (EnvUpdaterCtx *)malloc(sizeof(EnvUpdaterCtx));
    if (ctx == NULL) {
        printk("envUpdaterInit: error: failed to allocate EnvUpdaterCtx.\n");
        return NULL;
    }
    memset(ctx, 0, sizeof(*ctx));

    ctx->envVarManager = NotecardEnvVarManager_alloc();
    if (ctx->envVarManager == NULL) {
        printk("envUpdaterInit: error: NotecardEnvVarManager_new failed.\n");
        free(ctx);
        return NULL;
    }
    if (NotecardEnvVarManager_setEnvVarCb(ctx->envVarManager, envVarManagerCb,
            ctx) != NEVM_SUCCESS) {
        printk("envUpdaterInit: error: NotecardEnvVarManager_setEnvVarCb "
            "failed.\n");
        NotecardEnvVarManager_free(ctx->envVarManager);
        free(ctx);
        return NULL;
    }

    ctx->publisherCtx = publisherCtx;
    ctx->alarmPublisherCtx = alarmPublisherCtx;

    k_work_init(&ctx->envUpdateWorkItem, envUpdateWorkCb);
    k_timer_init(&ctx->envUpdateTimer, envUpdateTimerCb, NULL);

    printk("envUpdaterInit: Initialized environment variable updater.\n");

    return ctx;
}

/**
 * Start the environment variable update timer. Notehub will be checked
 * periodically for environment variable updates according to the interval.
 *
 * @param ctx      The environment variable updater context object.
 * @param interval The interval to check for updates, in seconds.
 *
 * @return True on success and false on failure.
 */
bool envUpdaterStart(EnvUpdaterCtx *ctx, uint32_t interval)
{
    if (ctx == NULL) {
        printk("envUpdaterStart: error: Called with NULL ctx.\n");
        return false;
    }
    if (interval == 0) {
        printk("envUpdaterStart: error: Called with 0 interval. Must be > 0."
            "\n");
        return false;
    }

    k_timer_start(&ctx->envUpdateTimer, K_SECONDS(0), K_SECONDS(interval));

    return true;
}

/**
 * Stop the environment variable update timer. Notehub won't be checked for
 * environment variable updates until envUpdaterStart is called again.
 *
 * @param ctx The environment variable updater context object.
 *
 * @return True on success and false on failure.
 */
bool envUpdaterStop(EnvUpdaterCtx *ctx)
{
    if (ctx == NULL) {
        printk("envUpdaterStop: error: Called with NULL ctx.\n");
        return false;
    }

    k_timer_stop(&ctx->envUpdateTimer);

    return true;
}

/**
 * Callback that will be executed when the environment variable update timer
 * expires.
 *
 * @param timer The timer handle.
 */
static void envUpdateTimerCb(struct k_timer *timer)
{
    EnvUpdaterCtx *ctx = CONTAINER_OF(timer, EnvUpdaterCtx, envUpdateTimer);
    k_work_submit(&ctx->envUpdateWorkItem);
}

/**
 * Callback that will be executed by the system workqueue when it's time to
 * check for environment variable updates.
 *
 * @param item The environment variable update work item.
 */
static void envUpdateWorkCb(struct k_work *item)
{
    EnvUpdaterCtx *ctx = CONTAINER_OF(item, EnvUpdaterCtx, envUpdateWorkItem);
    NotecardEnvVarManager_fetch(ctx->envVarManager, envVars, numEnvVars);
}
```

## src/publisher.c
```c
// Standard C headers.
#include <stdlib.h>
#include <string.h>

// Zephyr headers.
#include <zephyr/kernel.h>

// Notecard headers.
#include "note-c/note.h"

// Application headers.
#include "publisher.h"
#include "bme280.h"

struct PublisherCtx {
    const Bme280Ctx *bme280Ctx;
    struct k_work publishWorkItem;
    struct k_timer publishTimer;
};

// Forward declarations.
static void publishTimerCb(struct k_timer *timer);
static void publishWorkCb(struct k_work *item);

static bool publish(PublisherCtx* ctx)
{
    if (ctx == NULL) {
        printk("publish: error: Called with NULL ctx.\n");
        return false;
    }
    if (ctx->bme280Ctx == NULL) {
        printk("publish: error: Called with NULL ctx->bme280Ctx.\n");
        return false;
    }

    double temp, humidity, heatIndex;
    if (!bme280GetData(ctx->bme280Ctx, &temp, &humidity, &heatIndex)) {
        printk("publish: error: bme280GetData failed.\n");
        return false;
    }

    J *req = NoteNewRequest("note.add");
    if (req != NULL) {
        JAddStringToObject(req, "file", "data.qo");

        J *body = JCreateObject();
        if (body != NULL) {
            JAddNumberToObject(body, "temperature", temp);
            JAddNumberToObject(body, "humidity", humidity);
            JAddNumberToObject(body, "heat_index", heatIndex);
            JAddItemToObject(req, "body", body);

            if (!NoteRequest(req)) {
                printk("publish: error: NoteRequest failed.\n");
                return false;
            }
        }
        else {
            JDelete(req);
            printk("publish: error: Failed to create Note body.\n");
            return false;
        }
    }
    else {
        printk("publish: error: Failed to create note.add request.\n");
        return false;
    }

    return true;
}

/**
 * Allocate and initialize a new publisher context.
 *
 * @param bme280Ctx A BME280 context object.
 *
 * @return A valid PublisherCtx pointer on success and NULL on failure.
 */
PublisherCtx *publisherInit(const Bme280Ctx *bme280Ctx)
{
    if (bme280Ctx == NULL) {
        printk("publisherInit: error: Called with NULL bme280Ctx.\n");
        return NULL;
    }

    PublisherCtx *ctx = (PublisherCtx *)malloc(sizeof(PublisherCtx));
    if (ctx == NULL) {
        printk("publisherInit: error: failed to allocate PublisherCtx.\n");
        return NULL;
    }
    memset(ctx, 0, sizeof(*ctx));

    ctx->bme280Ctx = bme280Ctx;

    k_work_init(&ctx->publishWorkItem, publishWorkCb);
    k_timer_init(&ctx->publishTimer, publishTimerCb, NULL);

    printk("publisherInit: Initialized publisher.\n");

    return ctx;
}

/**
 * Start the publish timer. A Note will be published periodically according to
 * the interval.
 *
 * @param ctx      The publisher context object.
 * @param interval The publish interval, in seconds.
 *
 * @return True on success and false on failure.
 */
bool publisherStart(PublisherCtx *ctx, uint32_t interval)
{
    if (ctx == NULL) {
        printk("publisherStart: error: Called with NULL ctx.\n");
        return false;
    }
    if (interval == 0) {
        printk("publisherStart: error: Called with 0 interval. Must be > 0.\n");
        return false;
    }

    k_timer_start(&ctx->publishTimer, K_SECONDS(0), K_SECONDS(interval));

    return true;
}

/**
 * Stop the publish timer. No new Notes will be published until publisherStart
 * is called again.
 *
 * @param ctx The publisher context object.
 *
 * @return True on success and false on failure.
 */
bool publisherStop(PublisherCtx *ctx)
{
    if (ctx == NULL) {
        printk("publisherStop: error: Called with NULL ctx.\n");
        return false;
    }

    k_timer_stop(&ctx->publishTimer);

    return true;
}

/**
 * Callback that will be executed when the publish timer expires.
 *
 * @param timer The timer handle.
 */
static void publishTimerCb(struct k_timer *timer)
{
    PublisherCtx *ctx = CONTAINER_OF(timer, PublisherCtx, publishTimer);
    k_work_submit(&ctx->publishWorkItem);
}

/**
 * Callback that will be executed by the system workqueue when it's time to
 * publish.
 *
 * @param item The publish work item.
 */
static void publishWorkCb(struct k_work *item)
{
    PublisherCtx *ctx = CONTAINER_OF(item, PublisherCtx, publishWorkItem);
    publish(ctx);
}
```

## src/publisher.h
```c
#pragma once

// C standard headers.
#include <stdint.h>
#include <stdbool.h>

// Application headers.
#include "bme280.h"

struct PublisherCtx;
typedef struct PublisherCtx PublisherCtx;

PublisherCtx *publisherInit(const Bme280Ctx* bme280Ctx);
bool publisherStart(PublisherCtx *ctx, uint32_t interval);
bool publisherStop(PublisherCtx *ctx);
```
