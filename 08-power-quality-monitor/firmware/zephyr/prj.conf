## CMakeLists.txt
```
cmake_minimum_required(VERSION 3.20.0)

find_package(Zephyr REQUIRED HINTS $ENV{ZEPHYR_BASE})

project(power_quality_monitor)

set(SRC_DIR ${CMAKE_CURRENT_LIST_DIR}/src)
set(NOTE_C_SRC_DIR ${SRC_DIR}/note-c)
set(NEVM_SRC_DIR ${SRC_DIR}/notecard_env_var_manager/src)

target_sources(
    app
    PRIVATE
        # Application sources.
        ${SRC_DIR}/note_c_hooks.c
        ${SRC_DIR}/main.c
        # ${SRC_DIR}/UpbeatLabs_MCP39F521.cpp
        # note-c sources.
        ${NOTE_C_SRC_DIR}/n_atof.c
        ${NOTE_C_SRC_DIR}/n_cjson.c
        ${NOTE_C_SRC_DIR}/n_const.c
        ${NOTE_C_SRC_DIR}/n_helpers.c
        ${NOTE_C_SRC_DIR}/n_i2c.c
        ${NOTE_C_SRC_DIR}/n_printf.c
        ${NOTE_C_SRC_DIR}/n_serial.c
        ${NOTE_C_SRC_DIR}/n_ua.c
        ${NOTE_C_SRC_DIR}/n_b64.c
        ${NOTE_C_SRC_DIR}/n_cjson_helpers.c
        ${NOTE_C_SRC_DIR}/n_ftoa.c
        ${NOTE_C_SRC_DIR}/n_hooks.c
        ${NOTE_C_SRC_DIR}/n_md5.c
        ${NOTE_C_SRC_DIR}/n_request.c
        ${NOTE_C_SRC_DIR}/n_str.c
        # Notecard env var manager sources.
        ${NEVM_SRC_DIR}/NotecardEnvVarManager.c
)
target_include_directories(
    app
    PRIVATE
        ${SRC_DIR}
        ${NOTE_C_SRC_DIR}
        ${NEVM_SRC_DIR}
)
```

## prj.conf
```kconfig
# Provides access to onboard LED
CONFIG_GPIO=y

# Notecard Communication Channel
CONFIG_I2C=y

# Required by `note-c`
CONFIG_NEWLIB_LIBC=y

# Debugging Configuration
CONFIG_PRINTK=y

# Include Arduino API for library compatibility
CONFIG_ARDUINO_API=y
```

## src/main.c
```c
// Standard C headers.
#include <stdlib.h>

// Zephyr headers.
#include <zephyr/kernel.h>

// Notecard headers.
#include "note.h"
#include "note_c_hooks.h"

// Uncomment this line and replace com.your-company:your-product-name with your
// ProductUID.
// #define PRODUCT_UID "com.your-company:your-product-name"

#ifndef PRODUCT_UID
#define PRODUCT_UID ""
#pragma message "PRODUCT_UID is not defined in this example. Please ensure your Notecard has a product identifier set before running this example or define it in code here. More details at https://bit.ly/product-uid"
#endif

// Check for environment variable updates every minute.
#ifndef ENV_VAR_CHECK_INTERVAL
#define ENV_VAR_CHECK_INTERVAL 60
#endif

#ifndef HUB_SET_TIMEOUT
#define HUB_SET_TIMEOUT 5
#endif

#ifndef OUTBOUND_SYNC_INTERVAL
#define OUTBOUND_SYNC_INTERVAL 5
#endif

#ifndef NOTECARD_LOCK_POLL_INTERVAL
#define NOTECARD_LOCK_POLL_INTERVAL 10
#endif

// Notecard locking functions.
static bool notecardLocked = false;

// Attempt to get a lock on the I2C bus. This will spin forever until the lock
// is released.
void lockNotecard(void)
{
    while (notecardLocked) {
        NoteDelayMs(NOTECARD_LOCK_POLL_INTERVAL);
    }

    notecardLocked = true;
}

void unlockNotecard(void)
{
    notecardLocked = false;
}

void main(void)
{
    // Initialize note-c references.
    NoteSetFnDefault(malloc, free, platform_delay, platform_millis);
    NoteSetFnDebugOutput(noteLogPrint);
    NoteSetFnNoteMutex(lockNotecard, unlockNotecard);
    NoteSetFnI2C(NOTE_I2C_ADDR_DEFAULT, NOTE_I2C_MAX_DEFAULT, noteI2cReset,
                 noteI2cTransmit, noteI2cReceive);

    J *req = NoteNewRequest("hub.set");
    if (PRODUCT_UID[0]) {
       JAddStringToObject(req, "product", PRODUCT_UID);
    }
    JAddStringToObject(req, "mode", "periodic");
    // Sync outbound data every OUTBOUND_SYNC_INTERVAL minutes. Alarm notes will
    // still be synced immediately.
    JAddNumberToObject(req, "outbound", OUTBOUND_SYNC_INTERVAL);
    // The hub.set request may fail if it's sent shortly after power up. We use
    // NoteRequestWithRetry to give it a chance to succeed.
    if (!NoteRequestWithRetry(req, HUB_SET_TIMEOUT)) {
        printk("hub.set failed, aborting.\n");
        return;
    }

    while (true) {
        k_sleep(K_SECONDS(10));
    }
}
```

## src/UpbeatLabs_MCP39F521.h
```c
//*****************************************************************************
// UpbeatLabs_MCP39F521.h
//
// This is a library for the Upbeat Labs Dr. Wattson Energy Monitoring Board
// --> https://www.tindie.com/products/UpbeatLabs/dr-wattson-energy-monitoring-board-2/
//
// Written by Sridhar Rajagopal for Upbeat Labs LLC.
//
// BSD 3-Clause License

// Copyright (c) 2018, Upbeat Labs
// All rights reserved.

// Redistribution and use in source and binary forms, with or without
// modification, are permitted provided that the following conditions are met:

// * Redistributions of source code must retain the above copyright notice, this
//   list of conditions and the following disclaimer.

// * Redistributions in binary form must reproduce the above copyright notice,
//   this list of conditions and the following disclaimer in the documentation
//   and/or other materials provided with the distribution.

// * Neither the name of the copyright holder nor the names of its
//   contributors may be used to endorse or promote products derived from
//   this software without specific prior written permission.

// THIS SOFTWARE IS PROVIDED BY THE COPYRIGHT HOLDERS AND CONTRIBUTORS "AS IS"
// AND ANY EXPRESS OR IMPLIED WARRANTIES, INCLUDING, BUT NOT LIMITED TO, THE
// IMPLIED WARRANTIES OF MERCHANTABILITY AND FITNESS FOR A PARTICULAR PURPOSE ARE
// DISCLAIMED. IN NO EVENT SHALL THE COPYRIGHT HOLDER OR CONTRIBUTORS BE LIABLE
// FOR ANY DIRECT, INDIRECT, INCIDENTAL, SPECIAL, EXEMPLARY, OR CONSEQUENTIAL
// DAMAGES (INCLUDING, BUT NOT LIMITED TO, PROCUREMENT OF SUBSTITUTE GOODS OR
// SERVICES; LOSS OF USE, DATA, OR PROFITS; OR BUSINESS INTERRUPTION) HOWEVER
// CAUSED AND ON ANY THEORY OF LIABILITY, WHETHER IN CONTRACT, STRICT LIABILITY,
// OR TORT (INCLUDING NEGLIGENCE OR OTHERWISE) ARISING IN ANY WAY OUT OF THE USE
// OF THIS SOFTWARE, EVEN IF ADVISED OF THE POSSIBILITY OF SUCH DAMAGE.
//
//*****************************************************************************

#ifndef __UPBEATLABS_MCP39F521_H__
#define __UPBEATLABS_MCP39F521_H__

#include "Arduino.h"
#include "Wire.h"


/****************************************************************************/
/*    MACROS                                                                */
/****************************************************************************/

#define CALIBRATION_CURRENT 1035
#define CALIBRATION_VOLTAGE 852
#define CALIBRATION_POWER_ACTIVE 87
#define CALIBRATION_POWER_REACTIVE 0
#define LINE_FREQUENCY_REF 60000


/****************************************************************************/
/*    DATATYPES                                                             */
/****************************************************************************/

typedef struct UpbeatLabs_MCP39F521_Data {
	uint16_t systemStatus;
	uint16_t systemVersion;
	uint16_t voltageRMS;
	uint16_t lineFrequency;
	uint16_t analogInputVoltage;
	int16_t powerFactor;
	uint32_t currentRMS;
	uint32_t activePower;
	uint32_t reactivePower;
	uint32_t apparentPower;
} UpbeatLabs_MCP39F521_Data;

typedef struct UpbeatLabs_MCP39F521_FormattedData {
	uint16_t systemStatus;
	uint16_t systemVersion;
	float voltageRMS;
	float lineFrequency;
	float analogInputVoltage;
	float powerFactor;
	float currentRMS;
	float activePower;
	float reactivePower;
	float apparentPower;
} UpbeatLabs_MCP39F521_FormattedData;

typedef struct UpbeatLabs_MCP39F521_AccumData {
	uint64_t activeEnergyImport;
	uint64_t activeEnergyExport;
	uint64_t reactiveEnergyImport;
	uint64_t reactiveEnergyExport;
} UpbeatLabs_MCP39F521_AccumData;

typedef struct UpbeatLabs_MCP39F521_FormattedAccumData {
	double activeEnergyImport;
	double activeEnergyExport;
	double reactiveEnergyImport;
	double reactiveEnergyExport;
} UpbeatLabs_MCP39F521_FormattedAccumData;

typedef struct UpbeatLabs_MCP39F521_CalibrationData {
	uint16_t calibrationRegisterDelimiter;
	uint16_t gainCurrentRMS;
	uint16_t gainVoltageRMS;
	uint16_t gainActivePower;
	uint16_t gainReactivePower;
	int32_t offsetCurrentRMS;
	int32_t offsetActivePower;
	int32_t offsetReactivePower;
	int16_t dcOffsetCurrent;
	int16_t phaseCompensation;
	uint16_t apparentPowerDivisor;
} UpbeatLabs_MCP39F521_CalibrationData;

typedef struct UpbeatLabs_MCP39F521_FormattedCalibrationData {
	uint16_t calibrationRegisterDelimiter;
	uint16_t gainCurrentRMS;
	uint16_t gainVoltageRMS;
	uint16_t gainActivePower;
	uint16_t gainReactivePower;
	int32_t offsetCurrentRMS;
	int32_t offsetActivePower;
	int32_t offsetReactivePower;
	float dcOffsetCurrent;
	float phaseCompensation;
	uint16_t apparentPowerDivisor;
} UpbeatLabs_MCP39F521_FormattedCalibrationData;

typedef struct UpbeatLabs_MCP39F521_DesignConfigData {
	uint8_t rangeVoltage;
	uint8_t rangeCurrent;
	uint8_t rangePower;
	uint8_t rangeUnimplemented;
	uint32_t calibrationCurrent;
	uint16_t calibrationVoltage;
	uint32_t calibrationPowerActive;
	uint32_t calibrationPowerReactive;
	uint16_t lineFrequencyRef;
} UpbeatLabs_MCP39F521_DesignConfigData;

typedef struct UpbeatLabs_MCP39F521_EventFlagLimits {
  uint16_t voltageSagLimit;
  uint16_t voltageSurgeLimit;
  uint32_t overCurrentLimit;
  uint32_t overPowerLimit;
} UpbeatLabs_MCP39F521_EventFlagLimits;

class UpbeatLabs_MCP39F521
{
public:
  enum error_code {
    SUCCESS = 0,
    ERROR_INCORRECT_HEADER = 1,
    ERROR_CHECKSUM_FAIL = 2,
    ERROR_UNEXPECTED_RESPONSE = 3,
    ERROR_INSUFFICIENT_ARRAY_SIZE = 4,
    ERROR_CHECKSUM_MISMATCH = 5,
    ERROR_SET_VALUE_MISMATCH = 6
  };

  enum event_config {
    EVENT_OVERCUR_TST = 0,
    EVENT_OVERPOW_TST = 1,
    EVENT_VSAG_TST = 2,
    EVENT_VSUR_TST = 3,
    EVENT_OVERCUR_LA = 4,
    EVENT_OVERPOW_LA = 5,
    EVENT_VSAG_LA = 6,
    EVENT_VSUR_LA = 7,
    EVENT_VSAG_CL = 8,
    EVENT_VSUR_CL = 9,
    EVENT_OVERPOW_CL = 10,
    EVENT_OVERCUR_CL = 11,
    EVENT_MANUAL = 14,
    EVENT_VSAG_PIN = 16,
    EVENT_VSURGE_PIN = 17,
    EVENT_OVERCUR_PIN = 18,
    EVENT_OVERPOW_PIN = 19
  };

  enum system_status {
    SYSTEM_VSAG = 0,
    SYSTEM_VSURGE = 1,
    SYSTEM_OVERCUR = 2,
    SYSTEM_OVERPOW = 3,
    SYSTEM_SIGN_PA = 4,
    SYSTEM_SIGN_PR = 5,
    SYSTEM_EVENT = 10,
  };

  enum calibration_config {
    CALIBRATION_CONFIG_4A = 0,
    CALIBRATION_CONFIG_10A = 1, /* 30 ohm burden resistor x2 */
    CALIBRATION_CONFIG_15A = 2 /* 20 ohm burden resistor x2 */
  };

  UpbeatLabs_MCP39F521();

  void begin(uint8_t _addr = 0x74);

  int read(UpbeatLabs_MCP39F521_Data *output,
           UpbeatLabs_MCP39F521_AccumData *accumOutput);

  // Event control methods

  int readEventConfigRegister(uint32_t *value);

  int setEventConfigurationRegister(uint32_t value);

  int readEventFlagLimitRegisters(UpbeatLabs_MCP39F521_EventFlagLimits *output);

  int writeEventFlagLimitRegisters(UpbeatLabs_MCP39F521_EventFlagLimits *input);

  // EEPROM methods

  int bulkEraseEEPROM();
  int pageReadEEPROM(int pageNum, uint8_t *byteArray, int byteArraySize);
  int pageWriteEEPROM(int pageNum, uint8_t *byteArray, int byteArraySize);

  // Energy Accumulation methods

  int enableEnergyAccumulation(bool enable);
  int isEnergyAccumulationEnabled(bool *enabled);

  // Helper methods

  void convertRawData(UpbeatLabs_MCP39F521_Data *data,
                      UpbeatLabs_MCP39F521_FormattedData *fData);
  void convertRawAccumData(UpbeatLabs_MCP39F521_AccumData *data,
                           UpbeatLabs_MCP39F521_FormattedAccumData *fData);
  void convertRawCalibrationData(UpbeatLabs_MCP39F521_CalibrationData *data,
                       UpbeatLabs_MCP39F521_FormattedCalibrationData *fData);

  // START --- WARNING!!! WARNING!!! WARNING!!!
  // Advanced methods for calibration, etc
  // WARNING!!!! Use with extreme caution! These can render your Dr. Wattson
  // uncalibrated. Only use if you know what you are doing!

  int readCalibrationRegisters(UpbeatLabs_MCP39F521_CalibrationData *output);

  int writeGains(int gainCurrentRMS, int gainVoltageRMS,
                 int gainActivePower, int gainReactivePower);

  int readSystemConfigRegister(uint32_t *value);

  int setSystemConfigurationRegister(uint32_t value);

  int readAccumulationIntervalRegister(int *value);

  int setAccumulationIntervalRegister(int value);

  int readDesignConfigurationRegisters(UpbeatLabs_MCP39F521_DesignConfigData *output);

  int writeDesignConfigRegisters(UpbeatLabs_MCP39F521_DesignConfigData *data);

  int writePhaseCompensation(int16_t phaseCompensation);

  int readAndSetTemperature();
  int autoCalibrateGain();
  int autoCalibrateReactiveGain();
  int autoCalibrateFrequency();
  int calibratePhase(float pfExp);
  int saveToFlash();
  int factoryReset(); // This will revert the MCP39F521 to its default settings and
                      // remove any calibration data. Use with extreme caution!!!!
  int resetCalibration(calibration_config cc = CALIBRATION_CONFIG_4A );

  // END --- WARNING!!! WARNING!!! WARNING!!!


private:
  enum response_code {
    RESPONSE_ACK = 0x06,
    RESPONSE_NAK = 0x15,
    RESPONSE_CSFAIL = 0x51
  };

  enum command_code {
    COMMAND_REGISTER_READ_N_BYTES = 0x4e,
    COMMAND_REGISTER_WRITE_N_BYTES = 0x4d,
    COMMAND_SET_ADDRESS_POINTER = 0x41,
    COMMAND_SAVE_TO_FLASH = 0x53,
    COMMAND_PAGE_READ_EEPROM = 0x42,
    COMMAND_PAGE_WRITE_EEPROM = 0x50,
    COMMAND_BULK_ERASE_EEPROM = 0x4f,
    COMMAND_AUTO_CALIBRATE_GAIN = 0x5a,
    COMMAND_AUTO_CALIBRATE_REACTIVE_GAIN = 0x7a,
    COMMAND_AUTO_CALIBRATE_FREQUENCY = 0x76
  };

  int registerReadNBytes(int addressHigh, int addressLow, int numBytesToRead,
                         uint8_t *byteArray, int byteArraySize);
  int registerWriteNBytes(int addressHigh, int addressLow, int numBytes,
                          uint8_t *byteArray);
  int issueAckNackCommand(int command);
  int checkHeaderAndChecksum( int numBytesToRead, uint8_t *byteArray,
                              int byteArraySize);
  int checkHeader( int header);

  uint8_t i2c_addr;
  int _energy_accum_correction_factor;
};


#endif
```
